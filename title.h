#ifndef TITLE_H
#define TITLE_H

#include <Arduboy2.h>

// 95x64, 1 frame(s), 762 bytes
// Example: Sprites::drawOverwrite(x, y, logo, frame);
const uint8_t PROGMEM logo[] = {
  95, 64,
  0x00, 0x00, 0x00, 0x00, 0x00, 0x00, 0x00, 0x00, 0x00, 0x00, 0x00, 0x00,
  0x00, 0x00, 0x00, 0x00, 0x00, 0x00, 0x00, 0x00, 0x00, 0x00, 0x00, 0x00,
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  0x00, 0x00, 0x00, 0x00,
};

// 43x16, 2 frame(s), 174 bytes
// Example: Sprites::drawOverwrite(x, y, Start, frame);
const uint8_t PROGMEM start[] = {
  43, 16,
  // Frame 0
  0xff, 0x01, 0x01, 0x31, 0x49, 0x49, 0x49, 0x81, 0x01, 0x21, 0xf1, 0x21,
  0x21, 0x01, 0x41, 0xa1, 0xa1, 0xc1, 0x01, 0xc1, 0x21, 0x21, 0x01, 0x21,
  0xf1, 0x21, 0x21, 0x01, 0x01, 0x01, 0x01, 0x01, 0x01, 0x01, 0x01, 0x01,
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  0x10, 0x1f,
  // Frame 1
  0xff, 0xff, 0xff, 0xcf, 0xb7, 0xb7, 0xb7, 0x7f, 0xff, 0xdf, 0x0f, 0xdf,
  0xdf, 0xff, 0xbf, 0x5f, 0x5f, 0x3f, 0xff, 0x3f, 0xdf, 0xdf, 0xff, 0xdf,
  0x0f, 0xdf, 0xdf, 0xff, 0xff, 0xff, 0xff, 0xff, 0xff, 0xff, 0xff, 0xff,
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  0x1f, 0x1f,
};

// 43x16, 2 frame(s), 174 bytes
// Example: Sprites::drawOverwrite(x, y, Start, frame);
const uint8_t PROGMEM settings[] = {
  43, 16,
  // Frame 0
  0xff, 0x01, 0x01, 0x31, 0x49, 0x49, 0x49, 0x81, 0x01, 0xc1, 0xa1, 0xa1,
  0xc1, 0x01, 0x21, 0xf1, 0x21, 0x21, 0x01, 0x21, 0xf1, 0x21, 0x21, 0x01,
  0xc9, 0x01, 0xe1, 0x21, 0x21, 0xc1, 0x01, 0xc1, 0x21, 0x21, 0xd1, 0x01,
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  0x10, 0x1f,
  // Frame 1
  0xff, 0xff, 0xff, 0xcf, 0xb7, 0xb7, 0xb7, 0x7f, 0xff, 0x3f, 0x5f, 0x5f,
  0x3f, 0xff, 0xdf, 0x0f, 0xdf, 0xdf, 0xff, 0xdf, 0x0f, 0xdf, 0xdf, 0xff,
  0x37, 0xff, 0x1f, 0xdf, 0xdf, 0x3f, 0xff, 0x3f, 0xdf, 0xdf, 0x2f, 0xff,
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  0x1f, 0x1f,
};

// 34x16, 2 frame(s), 138 bytes
// Example: Sprites::drawOverwrite(x, y, help, frame);
const uint8_t PROGMEM help[] = {
  43, 16,
  // Frame 0
  0xff, 0x01, 0x01, 0xf9, 0x41, 0x41, 0x41, 0xf9, 0x01, 0xc1, 0xa1, 0xa1,
  0xc1, 0x01, 0xf9, 0x01, 0x01, 0xe1, 0x21, 0x21, 0xc1, 0x01, 0x01, 0x01,
  0x01, 0x01, 0x01, 0x01, 0x01, 0x01, 0x01, 0x01, 0x01, 0x01, 0x01, 0x01,
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  0x10, 0x1f,
  // Frame 1
  0xff, 0xff, 0xff, 0x07, 0xbf, 0xbf, 0xbf, 0x07, 0xff, 0x3f, 0x5f, 0x5f,
  0x3f, 0xff, 0x07, 0xff, 0xff, 0x1f, 0xdf, 0xdf, 0x3f, 0xff, 0xff, 0xff,
  0xff, 0xff, 0xff, 0xff, 0xff, 0xff, 0xff, 0xff, 0xff, 0xff, 0xff, 0xff,
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  0x1f, 0x1f,
};

// 43x16, 2 frame(s), 174 bytes
// Example: Sprites::drawOverwrite(x, y, credits, frame);
const uint8_t PROGMEM credits[] = {
  43, 16,
  // Frame 0
  0xff, 0x01, 0x01, 0xf1, 0x09, 0x09, 0x09, 0x11, 0x01, 0xc1, 0x21, 0x21,
  0x01, 0xc1, 0xa1, 0xa1, 0xc1, 0x01, 0xc1, 0x21, 0x21, 0xf9, 0x01, 0xc9,
  0x01, 0x21, 0xf1, 0x21, 0x21, 0x01, 0x41, 0xa1, 0xa1, 0x01, 0x01, 0x01,
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  0x10, 0x1f,
  // Frame 1
  0xff, 0xff, 0xff, 0x0f, 0xf7, 0xf7, 0xf7, 0xef, 0xff, 0x3f, 0xdf, 0xdf,
  0xff, 0x3f, 0x5f, 0x5f, 0x3f, 0xff, 0x3f, 0xdf, 0xdf, 0x07, 0xff, 0x37,
  0xff, 0xdf, 0x0f, 0xdf, 0xdf, 0xff, 0xbf, 0x5f, 0x5f, 0xff, 0xff, 0xff,
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  0x1f, 0x1f,
};

class Title {
  private:
    Arduboy2 *ab;
    int8_t selection = 0;
    bool startSel = true, helpSel = false, creditsSel = false, settingsSel = false;

  public:
    Title(Arduboy2 *ab_ptr) : ab(ab_ptr) {}

    void update() {
      if (ab->justPressed(UP_BUTTON)) {
        selection--;

        if (selection < 0) {
          selection = 3;
        }
      }

      if (ab->justPressed(DOWN_BUTTON)) {
        selection++;

        if (selection >= 4) {
          selection = 0;
        }
      }

      startSel = false;
      helpSel = false;
      settingsSel = false;
      creditsSel = false;

      switch (selection) {
        case 0:
          startSel = true;
          break;
        case 1:
          helpSel = true;
          break;
        case 2:
          settingsSel = true;
          break;
        case 3:
          creditsSel = true;
          break;
      }
    }

    int8_t getSelection() {
      return selection;
    }

    void draw() {
      uint8_t menuY = 1;

      Sprites::drawOverwrite(-11, 4, logo, 0);
      Sprites::drawOverwrite(85, menuY, start, startSel);
      Sprites::drawOverwrite(85, menuY + 16, help, helpSel);
      Sprites::drawOverwrite(85, menuY + 32, settings, settingsSel);
      Sprites::drawOverwrite(85, menuY + 48, credits, creditsSel);
    }
};

#endif